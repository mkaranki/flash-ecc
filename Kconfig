## Kconfig
```kconfig
# Copyright (c) Vaisala Oyj.
# SPDX-License-Identifier: BSD-3-Clause

rsource "lib/ecc_crc32/Kconfig"
rsource "drivers/flash/Kconfig"
```

## drivers/flash/Kconfig
```kconfig
# Copyright (c) Vaisala Oyj.
# SPDX-License-Identifier: BSD-3-Clause

config FLASH_ECC_SHIM
	bool "ECC flash shim driver"
	depends on FLASH
	select ECC_CRC32
	select FLASH_PAGE_LAYOUT
	help
	  Enables the ECC flash shim driver. Wraps a parent flash device and
	  adds transparent CRC-32 based error detection and correction per
	  physical page (252 bytes data + 4 bytes CRC-32 = 256 bytes).

	  Presents write_block_size=252 to upper layers. Each virtual 4032-byte
	  sector maps to one physical 4096-byte erase sector.

if FLASH_ECC_SHIM

config FLASH_ECC_SHIM_LOG_LEVEL
	int "ECC flash shim log level"
	default 3
	range 0 4
	help
	  Log level for the ECC flash shim driver.
	  0=OFF 1=ERR 2=WRN 3=INF 4=DBG

config FLASH_ECC_SHIM_SHELL
	bool "ECC flash shim shell test commands"
	depends on SHELL
	help
	  Adds the 'ecc_test' shell command group for hardware validation.

	  ecc_test inject <path>  — write a test file, locate it in physical
	  flash, inject a 1-bit error, and leave the file intact.

	  ecc_test verify <path>  — read the file back through LittleFS and
	  confirm the data is intact (run after reboot following inject).

	  Requires a 'storage_partition' fixed-partition node in the device tree
	  (the ECC-backed LittleFS partition).

endif # FLASH_ECC_SHIM
```

## dts/bindings/vaisala,ecc-flash-shim.yaml
```yaml
# Copyright (c) Vaisala Oyj.
# SPDX-License-Identifier: BSD-3-Clause

description: |
  Vaisala ECC flash shim driver.

  Wraps a parent NOR flash device to provide transparent CRC-32 based
  error detection and correction at the page level.

  Each physical page stores a data payload followed by a 4-byte CRC-32.
  The default geometry (data-size=252, pages-per-sector=16) targets standard
  256-byte/4096-byte NOR flash: 252 bytes data + 4 bytes CRC per page,
  16 pages per erase sector.

compatible: "vaisala,ecc-flash-shim"

properties:
  parent-flash:
    type: phandle
    required: true
    description: Parent flash device to wrap with ECC.

  data-size:
    type: int
    default: 252
    description: |
      Data payload bytes per physical page. The physical page size is
      data-size + 4 (CRC-32 overhead). Default 252 matches standard
      256-byte NOR flash pages.

  pages-per-sector:
    type: int
    default: 16
    description: |
      Number of physical pages per erase sector. Default 16 matches
      standard 4096-byte NOR flash sectors with 256-byte pages.
```

## lib/ecc_crc32/Kconfig
```kconfig
config ECC_CRC32
	bool "CRC-32 based ECC library"
	select CRC
	help
	  Enables the CRC-32 based error detection and correction library.
	  Provides 1-bit correction and optional 2-bit correction for data
	  buffers using CRC-32 (polynomial 0x04C11DB7, reflected).

	  For 2-bit correction the codeword (data + 4-byte CRC) must not
	  exceed 371 bytes.

if ECC_CRC32

config ECC_CRC32_2BIT_CORRECTION
	bool "Enable 2-bit error correction"
	default n
	help
	  Enables O(n²) brute-force 2-bit error correction in addition to
	  1-bit correction.

	  WARNING: on a Cortex-M33 at 160 MHz this takes ~250 ms per
	  uncorrectable page (codeword_bits = 2048, inner loop = 4M
	  iterations).  Any bulk read that hits multiple uncorrectable pages
	  will stall for minutes and may starve cooperative threads or
	  trigger a watchdog reset.

	  Leave disabled unless the application explicitly needs 2-bit
	  correction and can tolerate the latency.  With this disabled,
	  pages with 2-bit (or higher) errors are still correctly detected
	  and reported as UNCORRECTABLE; only correction is skipped.

endif # ECC_CRC32
```

## tests/ecc_crc32/testcase.yaml
```yaml
# Copyright (c) Vaisala Oyj.
# SPDX-License-Identifier: BSD-3-Clause

tests:
  ecc_crc32.unit:
    integration_platforms:
      - native_sim
    platform_allow: native_sim
```

## tests/flash_ecc_shim/testcase.yaml
```yaml
tests:
  flash_ecc_shim.stats:
    tags: flash-ecc
    platform_allow: native_sim
  flash_ecc_shim.stats_2bit_correction:
    tags: flash-ecc
    platform_allow: native_sim
    extra_configs:
      - CONFIG_ECC_CRC32_2BIT_CORRECTION=y
```
